## conf/layer.conf
```bitbake
# We have a conf and classes directory, append to BBPATH
BBPATH .= ":${LAYERDIR}"

# We have a recipes directory containing .bb and .bbappend files, add to BBFILES
BBFILES := "${BBFILES} ${LAYERDIR}/recipes*/*/*.bb \ 
            ${LAYERDIR}/recipes*/*/*.bbappend \
	    ${BBFILES} ${LAYERDIR}/recipes*/*/*/*.bb \ 
            ${LAYERDIR}/recipes*/*/*/*.bbappend \
"

BBFILE_COLLECTIONS += "neutrino-hd"
BBFILE_PATTERN_neutrino-hd := "^${LAYERDIR}/"
BBFILE_PRIORITY_neutrino-hd = "10"

# we want the good jpeg lib, not the ijg stuff
PREFERRED_PROVIDER_jpeg ?= "libjpeg-turbo"

# ...and the good ffmpeg...
PREFERRED_PROVIDER_ffmpeg ?= "ffmpeg"
# to get this we need to...
LICENSE_FLAGS_WHITELIST ?= "commercial"


# make cacao the preferred java compiler
PREFERRED_PROVIDER_virtual/java-native = "cacao-native"
PREFERRED_PROVIDER_virtual/java-initial-native = "cacao-initial-native"

# Additional license directories.
LICENSE_PATH += "${LAYERDIR}/files/custom-licenses"

# does not belong here ... move me
DISTRO_FEATURES_DEFAULT = "acl alsa argp bluetooth ext2 irda largefile pcmcia usbgadget usbhost wifi xattr nfs smbfs vfat ext2 acpi ppp zeroconf pci 3g nfc x11 pulseaudio systemd"
```
